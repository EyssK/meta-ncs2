## conf/layer.conf
```bitbake
# We have a conf and classes directory, add to BBPATH
BBPATH .= ":${LAYERDIR}"

# We have recipes-* directories, add to BBFILES
BBFILES += "${LAYERDIR}/recipes-*/*/*.bb \
            ${LAYERDIR}/recipes-*/*/*.bbappend"

BBFILE_COLLECTIONS += "meta-ncs2"
BBFILE_PATTERN_meta-ncs2 = "^${LAYERDIR}/"
BBFILE_PRIORITY_meta-ncs2 = "6"

LAYERDEPENDS_meta-ncs2 = "core"
LAYERSERIES_COMPAT_meta-ncs2 = "thud"
```
